&axi_ethernet_0 {
	phy-handle = <&phy0>;
	/delete-node/ mdio;
	axi_ethernet_mdio: mdio {
		#address-cells = <1>;
		#size-cells = <0>;
		phy0: phy@3 {
			device_type = "ethernet-phy";
			ti,6-wire-mode;
			ti,dp83867-rxctrl-strap-quirk;
			reg = <3>;
		};
	};
};
