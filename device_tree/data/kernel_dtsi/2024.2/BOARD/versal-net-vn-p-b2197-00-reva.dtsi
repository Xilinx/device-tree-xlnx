// SPDX-License-Identifier: GPL-2.0
/*
 * dts file for Xilinx ZynqMP VN-P-B2197-00 (Tenzing2)
 *
 * (C) Copyright 2022-2024 Advanced Micro Devices, Inc. All Rights Reserved.
 *
 * Michal Simek <michal.simek@amd.com>
 */


/ {
	compatible = "xlnx,versal-net-vn-p-b2197-00-revA",
		     "xlnx,versal-net-vn-p-b2197-00", "xlnx,versal-net";


	chosen {
		bootargs = "earlycon=pl011,mmio32,0xf1920000 console=ttyAMA0,115200n8 root=/dev/ram0 rw";
		stdout-path = "serial0:115200n8";
	};

/*	aliases {
		nvmem0 = &eeprom0;
		nvmem1 = &eeprom1;
	}; */
};

&i2c0 {
	/* Access via J70/J71 or J82/J83 */
	clock-frequency = <100000>;
};

&i2c1 {
	/* Access via J70/J71 or J82/J83 */
	/* By default this bus should have eeprom for board identification at 0x54 */
	/* SE/X-PRC card identification is also on this bus at 0x52 */
	clock-frequency = <100000>;
};
