// SPDX-License-Identifier: GPL-2.0
/*
 * dts file for Xilinx Versal
 *
 * (C) Copyright 2019, Xilinx, Inc.
 *
 * Michal Simek <michal.simek@xilinx.com>
 */

/ {
	compatible = "xlnx,versal-vc-p-a2197-00-revA",
		     "xlnx,versal-vc-p-a2197-00",
		     "xlnx,versal-vc-p-a2197", "xlnx,versal";
	model = "Xilinx Versal A2197 Processor board revA";

};

&dcc {
	status = "okay";
};
