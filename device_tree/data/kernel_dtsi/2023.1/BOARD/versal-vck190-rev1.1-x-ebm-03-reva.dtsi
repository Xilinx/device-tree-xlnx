// SPDX-License-Identifier: GPL-2.0
/*
 * dts file for Xilinx Versal VCK190 rev1.1 with X-EBM-03-revA module
 *
 * (C) Copyright 2019, Xilinx, Inc.
 *
 * Michal Simek <michal.simek@xilinx.com>
 */

#include "versal-vmk180-rev1.1-x-ebm-03-reva.dtsi"

/ {
        compatible = "xlnx,versal-vck190-rev1.1-x-ebm-03-revA",
                     "xlnx,versal-vck190-rev1.1", "xlnx,versal";
        model = "Xilinx Versal vck190 Eval board rev1.1 (OSPI)";
};
