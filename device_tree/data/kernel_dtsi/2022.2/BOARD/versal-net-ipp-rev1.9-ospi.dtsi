// SPDX-License-Identifier: GPL-2.0
/*
 * dts file for Xilinx Versal NET IPP/SPP OSPI
 *
 * (C) Copyright 2021-2022 Xilinx, Inc.
 * (C) Copyright 2022 Advanced Micro Devices, Inc. All Rights Reserved.
 *
 * Michal Simek <michal.simek@amd.com>
 */

#include "versal-net-ipp-rev1.9.dtsi"

/ {
	model = "Xilinx Versal NET SPP 5.0/IPP 1.9 OSPI";
};

&ospi {
	status = "okay";
};

&qspi {
	status = "disabled";
};
