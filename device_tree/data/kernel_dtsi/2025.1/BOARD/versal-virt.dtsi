// SPDX-License-Identifier: GPL-2.0+ OR MIT
/*
 * Empty device tree for versal-virt board
 *
 * Copyright 2021 Google LLC
 * (C) Copyright 2022-2024 Advanced Micro Devices, Inc. All Rights Reserved.
 */


/ {
	options {
		u-boot {
			compatible = "u-boot,config";
			bootscr-address = /bits/ 64 <0x20000000>;
		};
	};
};
