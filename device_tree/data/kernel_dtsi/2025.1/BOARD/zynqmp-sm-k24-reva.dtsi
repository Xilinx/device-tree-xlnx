// SPDX-License-Identifier: GPL-2.0
/*
 * dts file for Xilinx ZynqMP SM-K24 RevA
 *
 * (C) Copyright 2020-2022 Xilinx, Inc.
 * (C) Copyright 2022-2024 Advanced Micro Devices, Inc. All Rights Reserved.
 *
 * Michal Simek <michal.simek@amd.com>
 */

#include "zynqmp-sm-k26-reva.dtsi"

/ {
	model = "ZynqMP SM-K24 RevA/B/1";
	compatible = "xlnx,zynqmp-sm-k24-rev1", "xlnx,zynqmp-sm-k24-revB",
		     "xlnx,zynqmp-sm-k24-revA", "xlnx,zynqmp-sm-k24",
		     "xlnx,zynqmp";

};
