// SPDX-License-Identifier: GPL-2.0+
/*
 * dts file for Xilinx ZynqMP ZC1275
 *
 * (C) Copyright 2017-2022 Xilinx, Inc.
 * (C) Copyright 2022 Advanced Micro Devices, Inc. All Rights Reserved.
 *
 * Michal Simek <michal.simek@xilinx.com>
 * Siva Durga Prasad Paladugu <sivadur@xilinx.com>
 */


/ {
	model = "ZynqMP ZC1275 RevA";
	compatible = "xlnx,zynqmp-zc1275-revA", "xlnx,zynqmp-zc1275", "xlnx,zynqmp";

	aliases {
		serial0 = &uart0;
		serial1 = &dcc;
	};

};

&dcc {
	status = "okay";
};
